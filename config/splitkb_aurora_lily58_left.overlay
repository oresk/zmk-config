/*
 * Disable the OLED node on the left half — we use nice!view (Sharp SPI) instead.
 * The nice_view_adapter disables the I2C bus but the OLED child node remains active,
 * causing a pin conflict on P0.17/P0.20 (shared between I2C SDA/SCL and SPI MOSI/SCK).
 */
&oled {
    status = "disabled";
};
